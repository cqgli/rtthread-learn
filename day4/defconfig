## day4/defconfig
```kconfig
CONFIG_IDLE_THREAD_STACK_SIZE=1024
# CONFIG_RT_USING_TIMER_SOFT is not set
# CONFIG_RT_USING_DFS is not set
CONFIG_RT_USING_I2C=y
CONFIG_RT_USING_PWM=y
CONFIG_RT_USING_ULOG=y
```
